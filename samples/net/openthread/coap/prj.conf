## CMakeLists.txt
```
# SPDX-License-Identifier: Apache-2.0

cmake_minimum_required(VERSION 3.20.0)

find_package(Zephyr REQUIRED HINTS $ENV{ZEPHYR_BASE})
project(ot_coap)

target_include_directories(app PRIVATE src)

target_sources(app PRIVATE
    src/main.c
    src/coap_utils.c
    src/coap_shell.c
)

target_sources_ifdef(CONFIG_OT_COAP_SAMPLE_LED app PRIVATE src/led.c)
target_sources_ifdef(CONFIG_OT_COAP_SAMPLE_SW app PRIVATE src/button.c)
target_sources_ifdef(CONFIG_OT_COAP_SAMPLE_SRP app PRIVATE src/srp.c)

include(${ZEPHYR_BASE}/samples/net/common/common.cmake)

set(gen_dir ${ZEPHYR_BINARY_DIR}/include/generated/)
```

## Kconfig
```
# Config options for OpenThread Border CoAP sample app

# Copyright (c) 2024 Alexandre Bailon
# SPDX-License-Identifier: Apache-2.0

mainmenu "OpenThread CoAP Sample"

menu "Application configuration"

config OT_COAP_SAMPLE_SERVER
	bool "Build the sample CoAP server application"

config OT_COAP_SAMPLE_LED
	bool "Enable LED support"
	default y

config OT_COAP_SAMPLE_SW
	bool "Enable switch support"
	default y

config OT_COAP_SAMPLE_SRP
	bool "Enable SRP"
	select OPENTHREAD_SRP_CLIENT
	default y

endmenu

source "Kconfig.zephyr"
```

## prj.conf
```kconfig
CONFIG_NETWORKING=y
CONFIG_NET_L2_OPENTHREAD=y
CONFIG_OPENTHREAD_COAP=y
CONFIG_OPENTHREAD_SLAAC=y
CONFIG_JSON_LIBRARY=y

# Logging
CONFIG_LOG=y
CONFIG_LOG_MAX_LEVEL=1
CONFIG_LOG_MODE_MINIMAL=n
CONFIG_BOOT_BANNER=y
CONFIG_LOG_BACKEND_UART=y

# Kernel options
CONFIG_MAIN_STACK_SIZE=2560
CONFIG_INIT_STACKS=y

# Add features required for FTD CLI
CONFIG_SHELL=y
CONFIG_OPENTHREAD_SHELL=y
CONFIG_OPENTHREAD_PING_SENDER=y

# Network config
CONFIG_OPENTHREAD_PANID=4660
CONFIG_OPENTHREAD_XPANID="11:11:11:11:22:22:22:22"
CONFIG_OPENTHREAD_NETWORKKEY="00:11:22:33:44:55:66:77:88:99:aa:bb:cc:dd:ee:ff"
CONFIG_OPENTHREAD_CHANNEL=15
CONFIG_OPENTHREAD_NETWORK_NAME="OpenThreadDemo"

# SRP
CONFIG_MBEDTLS_HEAP_SIZE=8192
```

## src/main.c
```c
/*
 * Copyright (c) 2024 Alexandre Bailon
 *
 * SPDX-License-Identifier: Apache-2.0
 */

#include <zephyr/logging/log.h>
LOG_MODULE_REGISTER(coap);

#include <openthread/thread.h>
#include <coap_utils.h>

#ifdef CONFIG_OT_COAP_SAMPLE_LED
#include "led.h"
#endif /* CONFIG_OT_COAP_SAMPLE_LED */

#ifdef CONFIG_OT_COAP_SAMPLE_SW
#include <zephyr/drivers/gpio.h>
#include "button.h"

#ifdef CONFIG_OT_COAP_SAMPLE_SRP
#include "srp.h"
#endif

/*
 * Get button configuration from the devicetree sw0 alias. This is mandatory.
 */
#define SW0_NODE DT_ALIAS(sw0)
#if !DT_NODE_HAS_STATUS_OKAY(SW0_NODE)
#error "Unsupported board: sw0 devicetree alias is not defined"
#endif
static const struct gpio_dt_spec button = GPIO_DT_SPEC_GET_OR(SW0_NODE, gpios, {0});
static struct gpio_callback button_cb_data;

void button_pressed(const struct device *dev, struct gpio_callback *cb, uint32_t pins)
{
	coap_led_set_state("ff03::1", 0, LED_MSG_STATE_TOGGLE);
}
#endif /* CONFIG_OT_COAP_SAMPLE_SW */

static void on_thread_state_changed(otChangedFlags flags,
									struct openthread_context *ctx,
									void *data)
{
	if (flags & OT_CHANGED_THREAD_ROLE) {
		switch(otThreadGetDeviceRole(ctx->instance)) {
			case OT_DEVICE_ROLE_CHILD:
			case OT_DEVICE_ROLE_ROUTER:
			case OT_DEVICE_ROLE_LEADER:
			LOG_INF("Connected to a thread network!");
#ifdef CONFIG_OT_COAP_SAMPLE_SRP
				ot_srp_init();
				break;
#endif
			default:
			LOG_INF("Not connected to a thread network!");
				break;
		}
	}
}

static struct openthread_state_changed_cb ot_state_changed_cb = {
	.state_changed_cb = on_thread_state_changed,
};

int main(void)
{
	int ret;

	openthread_state_changed_cb_register(openthread_get_default_context(), &ot_state_changed_cb);

#ifdef CONFIG_OT_COAP_SAMPLE_SERVER
#ifdef CONFIG_OT_COAP_SAMPLE_LED
	coap_led_reg_rsc();
#endif /* CONFIG_OT_COAP_SAMPLE_LED */
#ifdef CONFIG_OT_COAP_SAMPLE_SW
	coap_btn_reg_rsc();
#endif /* CONFIG_OT_COAP_SAMPLE_SW */
#endif /* CONFIG_OT_COAP_SAMPLE_SERVER */

	ret = coap_init();
	if (ret) {
		return ret;
	}

#ifdef CONFIG_OT_COAP_SAMPLE_SW
	button_init(&button);

	gpio_init_callback(&button_cb_data, button_pressed, BIT(button.pin));
	gpio_add_callback_dt(&button, &button_cb_data);
#endif /*CONFIG_OT_COAP_SAMPLE_SW */

	return 0;
}
```

## src/srp.c
```c
/*
 * Copyright (c) 2024 Alexandre Bailon
 *
 * SPDX-License-Identifier: Apache-2.0
 */

#include <zephyr/sys/util.h>
#include <zephyr/logging/log.h>
LOG_MODULE_DECLARE(coap);

#include <openthread/link.h>
#include "srp.h"

static const char *SRP_INSTANCE_NAME = "ot-service";
static const char *SRP_SERVICE_NAME = "_coap_example._udp";
#define OT_DEFAULT_COAP_PORT 1234

static bool ot_srp_init_done = false;

void ot_srp_callback(otError aError, const otSrpClientHostInfo *aHostInfo,
		     const otSrpClientService *aServices,
		     const otSrpClientService *aRemovedServices, void *aContext)
{
	if (aError != OT_ERROR_NONE) {
		LOG_ERR("SRP update error: %s", otThreadErrorToString(aError));
	}
	LOG_INF("SRP update registered");
}

void ot_srp_set_host_name(otInstance *ot, char *host_name, uint16_t size)
{
	otExtAddress extAddress;

	otLinkGetFactoryAssignedIeeeEui64(ot, &extAddress);
    size = MIN(size, strlen(CONFIG_BOARD) + 1);
	strncpy(host_name, CONFIG_BOARD, size);
    strncat(host_name, "-", size);

	for (int i = 0; i < OT_EXT_ADDRESS_SIZE; i++) {
		char tmp[3];

		sprintf(tmp, "%02x", extAddress.m8[i]);
		strncat(host_name, tmp, size);
	}
}

int ot_srp_init(void)
{
	otError error;
	otInstance *ot;
	otSrpClientBuffersServiceEntry *entry;
	char *host_name;
	char *instance_name;
	char *service_name;
	uint16_t size;

	if (ot_srp_init_done) {
		return 0;
	}

	LOG_INF("Initializing SRP client");

	ot = openthread_get_default_instance();
	if (!ot) {
		LOG_ERR("Failed to get an OpenThread instance");
		return -ENODEV;
	}

	otSrpClientSetCallback(ot, ot_srp_callback, NULL);
	host_name = otSrpClientBuffersGetHostNameString(ot, &size);
	ot_srp_set_host_name(ot, host_name, size);
	error = otSrpClientSetHostName(ot, host_name);
	if (error != OT_ERROR_NONE) {
		LOG_ERR("Failed to set SRP host name: %s", otThreadErrorToString(error));
		return -1;
	}

	error = otSrpClientEnableAutoHostAddress(ot);
	if (error != OT_ERROR_NONE) {
		LOG_ERR("Failed to set SRP host address: %s", otThreadErrorToString(error));
		return -1;
	}

	entry = otSrpClientBuffersAllocateService(ot);
	if (entry == NULL) {
		LOG_ERR("Failed to allocate SRP service: %s", otThreadErrorToString(error));
		return -1;
	}
	entry->mService.mPort = OT_DEFAULT_COAP_PORT;

	instance_name = otSrpClientBuffersGetServiceEntryInstanceNameString(entry, &size);
	size = MIN(size, strlen(SRP_INSTANCE_NAME) + 1);
	memcpy(instance_name, SRP_INSTANCE_NAME, size);

	service_name = otSrpClientBuffersGetServiceEntryServiceNameString(entry, &size);
	size = MIN(size, strlen(SRP_SERVICE_NAME) + 1);
	memcpy(service_name, SRP_SERVICE_NAME, size);

	error = otSrpClientAddService(ot, &entry->mService);
	if (error != OT_ERROR_NONE) {
		LOG_ERR("Failed to register SRP service: %s", otThreadErrorToString(error));
		return -1;
	}

	otSrpClientEnableAutoStartMode(ot, NULL, NULL);

	ot_srp_init_done = true;

	return 0;
}
```

## src/srp.h
```c
/*
 * Copyright (c) 2024 Alexandre Bailon
 *
 * SPDX-License-Identifier: Apache-2.0
 */

#include <zephyr/net/openthread.h>
#include <openthread/srp_client_buffers.h>

int ot_srp_init(void);
```
