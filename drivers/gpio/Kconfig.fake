## drivers/gpio/Kconfig.fake
```kconfig
# Copyright (c) 2026 Alexandre Bailon
# SPDX-License-Identifier: Apache-2.0
 
config GPIO_FAKE
	bool "Fake GPIO controller"
	default y
	depends on DT_HAS_ZEPHYR_GPIO_FAKE_ENABLED
	help
	  Fake GPIO controller for testing purposes.
```

## subsys/led/Kconfig
```kconfig
# Copyright (c) 2026 BayLibre SAS
# SPDX-License-Identifier: Apache-2.0

config LED_PLAYER
	bool "Enable the LED player"
	depends on LED
	help
	  LED player allow to play an animation
	  on a LED.
	   This is useful when the LED is the only way
	   to get a status. using the LED player, we could
	   create an play a specific animation for each
	   status to report using the LED.
```

## tests/subsys/led/led_player/testcase.yaml
```yaml
common:
  platform_allow:
    - native_sim
  integration_platforms:
    - native_sim
tests:
  subsys.led.led_player: {}
```

## tests/subsys/led/status_led/testcase.yaml
```yaml
common:
  platform_allow:
    - native_sim
  integration_platforms:
    - native_sim
tests:
  subsys.led.status_led: {}
```
